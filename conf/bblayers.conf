## conf/bblayers.conf
```bitbake
# POKY_BBLAYERS_CONF_VERSION is increased each time build/conf/bblayers.conf
# changes incompatibly
POKY_BBLAYERS_CONF_VERSION = "2"

BBPATH = "${TOPDIR}"
BBFILES ?= ""

BBLAYERS ?= " \
  ${HOME}/yocto_release/meta-olli \
  ${HOME}/yocto_release/meta-nodejs \
  ${HOME}/yocto_release/poky/meta \
  ${HOME}/yocto_release/poky/meta-poky \
  ${HOME}/yocto_release/poky/meta-openembedded/meta-oe \
  ${HOME}/yocto_release/poky/meta-openembedded/meta-networking \
  ${HOME}/yocto_release/poky/meta-openembedded/meta-python \
  ${HOME}/yocto_release/poky/meta-openembedded/meta-multimedia \
  ${HOME}/yocto_release/poky/meta-openembedded/meta-systemd \
"
```

## conf/layer.conf
```bitbake
# We have a conf and classes directory, add to BBPATH
BBPATH .= ":${LAYERDIR}"

# We have recipes-* directories, add to BBFILES
BBFILES += "${LAYERDIR}/recipes-*/*/*.bb \
	${LAYERDIR}/recipes-*/*/*.bbappend"

BBFILE_COLLECTIONS += "olli"
BBFILE_PATTERN_olli = "^${LAYERDIR}/"
BBFILE_PRIORITY_olli = "20"
```

## conf/local.conf
```bitbake
MACHINE = "beaglebone"

DISTRO ?= "poky"

PACKAGE_CLASSES ?= "package_ipk"

EXTRA_IMAGE_FEATURES ?= "debug-tweaks"

PREFERRED_PROVIDER_udev = "eudev"
VIRTUAL_RUNTIME_init_manager = "sysvinit"

# To change kernel version
PREFERRED_VERSION_olli-linux = "4.4%"

USER_CLASSES ?= "buildstats image-mklibs image-prelink"

PATCHRESOLVE = "noop"

BB_DISKMON_DIRS = "\
    STOPTASKS,${TMPDIR},1G,100K \
    STOPTASKS,${DL_DIR},1G,100K \
    STOPTASKS,${SSTATE_DIR},1G,100K \
    STOPTASKS,/tmp,100M,100K \
    ABORT,${TMPDIR},100M,1K \
    ABORT,${DL_DIR},100M,1K \
    ABORT,${SSTATE_DIR},100M,1K \
    ABORT,/tmp,10M,1K"

RM_OLD_IMAGE = "1"

#mgp123
LICENSE_FLAGS_WHITELIST_append = " commercial_mpg123"

LICENSE_FLAGS_WHITELIST_append = " commercial_ffmpeg"
LICENSE_FLAGS_WHITELIST_append = " commercial_x264"

LICENSE_FLAGS_WHITELIST_append = " commercial_libmad"
#systemd
DISTRO_FEATURES_append = " systemd"
VIRTUAL-RUNTIME_init_manager = "systemd"

#nodejs
#PREFERRED_VERSION_gcc = "linaro-4.9%"
PREFERRED_VERSION_nodejs = "8.11.3"
PREFERRED_VERSION_nodejs-native = "8.11.3"
#PREFERRED_VERSION_networkmanager = "1.0.12"
PREFERRED_VERSION_mpg123 = "1.23.6"
DISTRO_FEATURES_remove = " pulseaudio 3g "

#libusb1
PREFERRED_VERSION_libusb1 = "1.0.20"

#fixed error connmanctl
DISTRO_FEATURES_append += "wifi"

INHERIT += "rm_work"

CONF_VERSION = "1"
```
